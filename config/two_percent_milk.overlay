#include <dt-bindings/zmk/matrix_transform.h>

/ {
chosen {
        zmk,kscan = &kscan4;
        zmk,matrix-transform = <&matrix_transform>;
    };

    kscan4: kscan_0 {
    compatible = "zmk,kscan-gpio-matrix";
    diode-direction = "row2col";

    col-gpios=
        <&gpio0 6 GPIO_ACTIVE_HIGH>,
        <&gpio0 8 GPIO_ACTIVE_HIGH>,
        <&gpio0 17 GPIO_ACTIVE_HIGH>,
        <&gpio0 20 GPIO_ACTIVE_HIGH>,
        <&gpio0 22 GPIO_ACTIVE_HIGH>,
        <&gpio0 24 GPIO_ACTIVE_HIGH>,
        <&gpio0 0 GPIO_ACTIVE_HIGH>,
        <&gpio0 11 GPIO_ACTIVE_HIGH>,
        <&gpio1 4 GPIO_ACTIVE_HIGH>,
        <&gpio1 6 GPIO_ACTIVE_HIGH>;

    row-gpios=
        <&gpio1 1 (GPIO_PULL_DOWN)>,
        <&gpio1 2 (GPIO_PULL_DOWN)>,
        <&gpio1 7 (GPIO_PULL_DOWN)>,
        <&gpio0 9 (GPIO_PULL_DOWN)>,
        <&gpio0 10 (GPIO_PULL_DOWN)>,
        <&gpio1 11 (GPIO_PULL_DOWN)>,
        <&gpio1 13 (GPIO_PULL_DOWN)>,
        <&gpio1 15 (GPIO_PULL_DOWN)>,
        <&gpio0 2 (GPIO_PULL_DOWN)>,
        <&gpio0 29 (GPIO_PULL_DOWN)>,
        <&gpio0 31 (GPIO_PULL_DOWN)>;
    };

    matrix_transform: matrix_transform {
        compatible = "zmk,matrix-transform";
        columns = <10>;
        rows = <11>;
        col-offset = <0>;
        row-offset = <0>;
        map = < 0 1 2 3 4 5 6 7 
                8 9 10 11 12 13 14 15 
                16 17 18 19 20 21 22 23 
                24 25 26 27 28 29 30 31 
                32 33 34 35 36 37 38 39 
                40 41 42 43 44 45 46 47 
                48 49 50 51 52 53 54 55 
                56 57 58 59 60 61 62 63 
                64 65 66 67 68 69 70 71
                72 73 74 75 76 77 78 79
                80 81 82 83 84 85 86 87
                88 89 90 91 92 93 94 95
                96 97 98 99 100 101 102
                103 104>;
    };
  };
